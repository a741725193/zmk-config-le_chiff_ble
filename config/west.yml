## config/west.yml
```yaml
manifest:
  remotes:
    - name: cormoran
      url-base: https://github.com/cormoran
    - name: zmkfirmware
      url-base: https://github.com/zmkfirmware
    - name: mctechnology17
      url-base: https://github.com/mctechnology17
    - name: nxtkb
      url-base: https://github.com/nxtkb
    - name: tokyo2006
      url-base: https://github.com/tokyo2006
  projects:
    - name: zmk
      remote: cormoran
      revision: v0.3-branch+dya
      import: app/west.yml
    - name: zmk-behavior-runtime-sensor-rotate
      remote: cormoran
      revision: main
    - name: zmk-module-ble-management
      remote: cormoran
      revision: zmk-v0.3.0.0
    - name: zmk-module-battery-history
      remote: cormoran
      revision: main
    - name: zmk-module-settings-rpc
      remote: cormoran
      revision: main
    - name: zmk-module-runtime-input-processor
      remote: cormoran
      revision: zmk-v0.3.0.0
    - name: zmk-feature-module-physical-layout
      remote: cormoran
      revision: 244a903
    - name: zmk-nice-oled
      remote: mctechnology17
      revision: main
    - name: cirque-input-module
      remote: tokyo2006
      revision: fix/endpoint-api
  self:
    path: config
```
