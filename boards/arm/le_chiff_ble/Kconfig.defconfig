## boards/arm/le_chiff_ble/Kconfig.defconfig
```kconfig
# Copyright (c) 2021 @MangoIV
# SPDX-License-Identifier: MIT

if BOARD_LE_CHIFF_BLE

config BOARD
	default "le_chiff_ble"

config ZMK_KEYBOARD_NAME
	default "Le Chiffre"

if ZMK_DISPLAY

config I2C
    default y

config SSD1306
    default y

choice ZMK_DISPLAY_WORK_QUEUE
    default ZMK_DISPLAY_WORK_QUEUE_DEDICATED
endchoice

endif

if SSD1306

config LV_Z_VDB_SIZE
    default 64

config LV_DPI_DEF
    default 148

config LV_Z_BITS_PER_PIXEL
    default 1

choice LV_COLOR_DEPTH
    default LV_COLOR_DEPTH_1
endchoice

endif

if USB

config USB_NRFX
	default y

config USB_DEVICE_STACK
	default y

endif # USB

config BT_CTLR
	default BT

config ZMK_BLE
	default y

config ZMK_USB
	default y

config ZMK_BATTERY_VOLTAGE_DIVIDER
	default y

endif # BOARD_LE_CHIFF_BLE
```
